## CMakeLists.txt
```
cmake_minimum_required(VERSION 3.20.0)

# Zephyr expects the project to find the Zephyr package
find_package(Zephyr REQUIRED HINTS $ENV{ZEPHYR_BASE})

project(embedded_sensor_interface)

# Add source files
target_sources(app PRIVATE
    src/main.c
    src/uart_protocol.c
    src/sensor_sim.c
    src/parameters.c
    src/state_machine.c
)
```

## prj.conf
```kconfig
# General project config
CONFIG_MAIN_STACK_SIZE=2048
CONFIG_SYSTEM_WORKQUEUE_STACK_SIZE=1024

# Enable Logging
CONFIG_LOG=y
CONFIG_LOG_DEFAULT_LEVEL=3

# Enable UART
CONFIG_SERIAL=y
CONFIG_UART_INTERRUPT_DRIVEN=y

# native_sim specific PTY support (this allows host tools to connect to it)
CONFIG_UART_NATIVE_PTY_0_ON_STDINOUT=n

CONFIG_UART_NATIVE_PTY_AUTOATTACH_DEFAULT_CMD="ln -sf %s pty.link"

# Enable I2C API for sensor simulation
# Although we simulate the sensor in software, we want to compile the driver interface
CONFIG_I2C=y

# Enable assertions to fail fast on errors
CONFIG_ASSERT=y
CONFIG_CRC=y
```

## src/main.c
```c
#include <zephyr/kernel.h>
#include <zephyr/logging/log.h>

#include "state_machine.h"
#include "parameters.h"
#include "sensor_sim.h"

LOG_MODULE_REGISTER(main, LOG_LEVEL_DBG);

static struct k_timer tick_timer;
static struct k_work_q tick_work_q;
static K_THREAD_STACK_DEFINE(tick_work_q_stack, CONFIG_SYSTEM_WORKQUEUE_STACK_SIZE);

// Work item for running statemachine and sampling
static struct k_work state_machine_work;

static void tick_work_handler(struct k_work *work) {
    state_machine_run_iteration();
}

static void tick_timer_handler(struct k_timer *timer_id) {
    k_work_submit_to_queue(&tick_work_q, &state_machine_work);
}

int main(void)
{
    LOG_INF("Starting Embedded Sensor Interface Module");
    
    // Explicit initialization of state machine logic.
    // It is up to state machine to call parameters_init(), etc on STATE_INIT.
    state_machine_init();

    // Start a dedicated work queue for our 1ms ticks
    k_work_queue_start(&tick_work_q, tick_work_q_stack,
                       K_THREAD_STACK_SIZEOF(tick_work_q_stack),
                       K_PRIO_COOP(7), NULL);

    k_work_init(&state_machine_work, tick_work_handler);
    
    // Timer running at 1ms (1000Hz)
    k_timer_init(&tick_timer, tick_timer_handler, NULL);
    k_timer_start(&tick_timer, K_MSEC(1), K_MSEC(1));

    // The main thread can just sleep, all action happens in interrupts/work_queue
    while (1) {
        k_sleep(K_FOREVER);
    }
    return 0;
}
```

## src/parameters.c
```c
#include "parameters.h"
#include <zephyr/logging/log.h>

LOG_MODULE_REGISTER(params, LOG_LEVEL_DBG);

typedef struct {
    uint16_t sample_rate;
    uint16_t status_period_ms;
    bool sensor_enable;
} param_store_t;

static param_store_t current_params;

void parameters_init(void) {
    current_params.sample_rate = 100;
    current_params.status_period_ms = 1000;
    current_params.sensor_enable = true;
    LOG_INF("Parameters initialized to defaults");
}

uint16_t parameters_get_sample_rate(void) {
    return current_params.sample_rate;
}

bool parameters_set_sample_rate(uint16_t rate) {
    if (rate >= 1 && rate <= 1000) {
        current_params.sample_rate = rate;
        LOG_INF("Set SENSOR_SAMPLE_RATE = %u", rate);
        return true;
    }
    LOG_WRN("Invalid SENSOR_SAMPLE_RATE: %u", rate);
    return false;
}

uint16_t parameters_get_status_period(void) {
    return current_params.status_period_ms;
}

bool parameters_set_status_period(uint16_t period_ms) {
    if (period_ms >= 100 && period_ms <= 5000) {
        current_params.status_period_ms = period_ms;
        LOG_INF("Set STATUS_PERIOD_MS = %u", period_ms);
        return true;
    }
    LOG_WRN("Invalid STATUS_PERIOD_MS: %u", period_ms);
    return false;
}

bool parameters_get_sensor_enable(void) {
    return current_params.sensor_enable;
}

bool parameters_set_sensor_enable(bool enable) {
    current_params.sensor_enable = enable;
    LOG_INF("Set SENSOR_ENABLE = %d", enable);
    return true;
}
```

## src/parameters.h
```c
#ifndef PARAMETERS_H
#define PARAMETERS_H

#include <stdint.h>
#include <stdbool.h>

// Parameter IDs
#define PARAM_SENSOR_SAMPLE_RATE 0x01
#define PARAM_STATUS_PERIOD_MS   0x02
#define PARAM_SENSOR_ENABLE      0x03

void parameters_init(void);

uint16_t parameters_get_sample_rate(void);
bool parameters_set_sample_rate(uint16_t rate);

uint16_t parameters_get_status_period(void);
bool parameters_set_status_period(uint16_t period_ms);

bool parameters_get_sensor_enable(void);
bool parameters_set_sensor_enable(bool enable);

#endif /* PARAMETERS_H */
```

## src/sensor_sim.c
```c
#include "sensor_sim.h"
#include <zephyr/logging/log.h>

LOG_MODULE_REGISTER(sensor, LOG_LEVEL_DBG);

static uint16_t current_value;
static sensor_fault_mode_t current_fault;

void sensor_sim_init(void) {
    current_value = 0;
    current_fault = FAULT_NONE;
    LOG_INF("Sensor simulator initialized (I2C interface mocked)");
}

uint16_t sensor_sim_read(void) {
    switch (current_fault) {
        case FAULT_NO_RESPONSE:
            LOG_ERR("Sensor reading failed: NO_RESPONSE on mock I2C bus");
            // Could return 0xFFFF or trigger state machine error,
            // let's return a distinct invalid looking value
            return 0xFFFF;
            
        case FAULT_OUT_OF_RANGE:
            return 0xFFFE;
            
        case FAULT_STUCK:
            return current_value; // Return the same value as last time
            
        case FAULT_NONE:
        default:
            current_value++;
            if (current_value >= 0xFF00) { current_value = 0; }
            return current_value;
    }
}

void sensor_sim_inject_fault(sensor_fault_mode_t mode) {
    current_fault = mode;
    LOG_WRN("Injected sensor fault mode: %d", mode);
}
```

## src/sensor_sim.h
```c
#ifndef SENSOR_SIM_H
#define SENSOR_SIM_H

#include <stdint.h>
#include <stdbool.h>

void sensor_sim_init(void);
uint16_t sensor_sim_read(void);

// Test hooks
typedef enum {
    FAULT_NONE,
    FAULT_NO_RESPONSE,
    FAULT_OUT_OF_RANGE,
    FAULT_STUCK
} sensor_fault_mode_t;

void sensor_sim_inject_fault(sensor_fault_mode_t mode);

#endif /* SENSOR_SIM_H */
```

## src/state_machine.c
```c
#include "state_machine.h"
#include "parameters.h"
#include "sensor_sim.h"
#include "uart_protocol.h"
#include <zephyr/kernel.h>
#include <zephyr/logging/log.h>

LOG_MODULE_REGISTER(sm, LOG_LEVEL_DBG);

static system_state_t current_state;
static uint32_t uptime_ms;
static uint32_t error_flags;
static int64_t last_tick;

void state_machine_init(void) {
    current_state = STATE_BOOT;
    uptime_ms = 0;
    error_flags = 0;
    last_tick = k_uptime_get();
    LOG_INF("State Machine Initialized in BOOT");
}

system_state_t state_machine_get_current(void) {
    return current_state;
}

uint32_t state_machine_get_uptime_ms(void) {
    return uptime_ms;
}

uint32_t state_machine_get_error_flags(void) {
    return error_flags;
}

void state_machine_trigger_error(void) {
    if (current_state != STATE_ERROR) {
        LOG_ERR("Triggering ERROR state");
        current_state = STATE_ERROR;
        error_flags |= 0x01; // General error flag
    }
}

void state_machine_trigger_reset(void) {
    LOG_WRN("Triggering RESET -> RECOVERY state");
    current_state = STATE_RECOVERY;
}

static void transition_to(system_state_t new_state) {
    LOG_INF("Transition: %d -> %d", current_state, new_state);
    current_state = new_state;
}

void state_machine_run_iteration(void) {
    int64_t now = k_uptime_get();
    uptime_ms += (now - last_tick);
    last_tick = now;

    switch (current_state) {
        case STATE_BOOT:
            // Simulate trivial bootup checks
            transition_to(STATE_INIT);
            break;

        case STATE_INIT:
            parameters_init();
            sensor_sim_init();
            uart_protocol_init();
            transition_to(STATE_RUN);
            break;

        case STATE_RUN:
            // Main active state handled by interrupts/timers
            // Nothing explicitly blocked here in the tick
            break;

        case STATE_ERROR:
            // Wait for reset command or watchdog (if we had one)
            // Just sit in error unless reset requested
            break;

        case STATE_RECOVERY:
            // Best effort clear and re-init
            error_flags = 0;
            transition_to(STATE_INIT);
            break;

        default:
            transition_to(STATE_ERROR);
            break;
    }
}
```

## src/state_machine.h
```c
#ifndef STATE_MACHINE_H
#define STATE_MACHINE_H

#include <stdint.h>
#include <stdbool.h>

typedef enum {
    STATE_BOOT = 0,
    STATE_INIT = 1,
    STATE_RUN = 2,
    STATE_ERROR = 3,
    STATE_RECOVERY = 4
} system_state_t;

void state_machine_init(void);
system_state_t state_machine_get_current(void);

// Call this from main loop
void state_machine_run_iteration(void);

// External triggers
void state_machine_trigger_error(void);
void state_machine_trigger_reset(void);

uint32_t state_machine_get_uptime_ms(void);
uint32_t state_machine_get_error_flags(void);

#endif /* STATE_MACHINE_H */
```

## src/uart_protocol.c
```c
#include "uart_protocol.h"
#include "parameters.h"
#include "sensor_sim.h"
#include "state_machine.h"
#include <zephyr/kernel.h>
#include <zephyr/device.h>
#include <zephyr/drivers/uart.h>
#include <zephyr/sys/crc.h>
#include <zephyr/logging/log.h>
#include <string.h>

LOG_MODULE_REGISTER(uart, LOG_LEVEL_DBG);

static const struct device *uart_dev = DEVICE_DT_GET(DT_NODELABEL(uart0)); // native_sim PTY uart

#define MAX_PAYLOAD_LEN 64
#define RX_BUF_SIZE 128
static uint8_t rx_buf[RX_BUF_SIZE];
static size_t rx_idx = 0;

static uint32_t rx_err_cnt = 0;
static uint32_t tx_err_cnt = 0;

typedef enum {
    SYNC0, SYNC1, VERSION, TYPE, LEN0, LEN1, PAYLOAD, CRC0, CRC1
} parser_state_t;

static parser_state_t p_state = SYNC0;
static uint8_t p_type = 0;
static uint16_t p_len = 0;
static uint8_t p_payload[MAX_PAYLOAD_LEN];
static uint16_t p_payload_idx = 0;
static uint16_t p_crc_rx = 0;

static void send_frame(uint8_t type, uint8_t *payload, uint16_t len) {
    if (!device_is_ready(uart_dev)) return;

    uint8_t header[6] = {
        FRAME_PREAMBLE_0, FRAME_PREAMBLE_1,
        FRAME_VERSION, type,
        (uint8_t)(len >> 8), (uint8_t)(len & 0xFF)
    };
    
    // CRC over version + type + length + payload
    uint16_t crc = crc16_ccitt(0xFFFF, &header[2], 4);
    if (len > 0) {
        crc = crc16_ccitt(crc, payload, len);
    }
    
    // Write header
    for (int i=0; i<6; i++) uart_poll_out(uart_dev, header[i]);
    // Write Payload
    for (int i=0; i<len; i++) uart_poll_out(uart_dev, payload[i]);
    // Write CRC
    uart_poll_out(uart_dev, (uint8_t)(crc >> 8));
    uart_poll_out(uart_dev, (uint8_t)(crc & 0xFF));
}

static void handle_get_status(void) {
    uint8_t payload[18];
    
    payload[0] = (uint8_t)state_machine_get_current();
    uint32_t uptime = state_machine_get_uptime_ms();
    payload[1] = (uptime >> 24) & 0xFF;
    payload[2] = (uptime >> 16) & 0xFF;
    payload[3] = (uptime >> 8) & 0xFF;
    payload[4] = uptime & 0xFF;
    
    uint32_t err_flags = state_machine_get_error_flags();
    payload[5] = (err_flags >> 24) & 0xFF;
    payload[6] = (err_flags >> 16) & 0xFF;
    payload[7] = (err_flags >> 8) & 0xFF;
    payload[8] = err_flags & 0xFF;
    
    payload[9] = (rx_err_cnt >> 24) & 0xFF;
    payload[10] = (rx_err_cnt >> 16) & 0xFF;
    payload[11] = (rx_err_cnt >> 8) & 0xFF;
    payload[12] = rx_err_cnt & 0xFF;
    
    payload[13] = (tx_err_cnt >> 24) & 0xFF;
    payload[14] = (tx_err_cnt >> 16) & 0xFF;
    payload[15] = (tx_err_cnt >> 8) & 0xFF;
    payload[16] = tx_err_cnt & 0xFF;
    
    // Placeholder flags for sensor faults
    payload[17] = 0; 
    
    send_frame(MSG_STATUS_RSP, payload, 18);
}

static void handle_set_param(uint8_t *data, uint16_t len) {
    if (len < 1) goto err;
    uint8_t param_id = data[0];
    bool ok = false;
    
    if (param_id == PARAM_SENSOR_SAMPLE_RATE && len == 3) {
        uint16_t rate = (data[1] << 8) | data[2];
        ok = parameters_set_sample_rate(rate);
    } else if (param_id == PARAM_STATUS_PERIOD_MS && len == 3) {
        uint16_t period = (data[1] << 8) | data[2];
        ok = parameters_set_status_period(period);
    } else if (param_id == PARAM_SENSOR_ENABLE && len == 2) {
        ok = parameters_set_sensor_enable(data[1] ? true : false);
    }
    
    if (ok) {
        // Echo back GET param style essentially or just empty success
        uint8_t rsp[1] = {0x00}; // 0 = OK
        send_frame(MSG_PARAM_RSP, rsp, 1);
        return;
    }
err:
    {
        uint8_t r[1] = {0x01}; // Error
        send_frame(MSG_ERROR_RSP, r, 1);
    }
}

static void handle_get_param(uint8_t *data, uint16_t len) {
    if (len < 1) return;
    uint8_t param_id = data[0];
    
    uint8_t rsp[4];
    rsp[0] = param_id;
    
    if (param_id == PARAM_SENSOR_SAMPLE_RATE) {
        uint16_t v = parameters_get_sample_rate();
        rsp[1] = (v >> 8) & 0xFF;
        rsp[2] = v & 0xFF;
        send_frame(MSG_PARAM_RSP, rsp, 3);
    } else if (param_id == PARAM_STATUS_PERIOD_MS) {
        uint16_t v = parameters_get_status_period();
        rsp[1] = (v >> 8) & 0xFF;
        rsp[2] = v & 0xFF;
        send_frame(MSG_PARAM_RSP, rsp, 3);
    } else if (param_id == PARAM_SENSOR_ENABLE) {
        bool v = parameters_get_sensor_enable();
        rsp[1] = v ? 1 : 0;
        send_frame(MSG_PARAM_RSP, rsp, 2);
    }
}

static void process_frame(void) {
    uint8_t header[4] = {FRAME_VERSION, p_type, (uint8_t)(p_len >> 8), (uint8_t)(p_len & 0xFF)};
    uint16_t expected_crc = crc16_ccitt(0xFFFF, header, 4);
    if (p_len > 0) {
        expected_crc = crc16_ccitt(expected_crc, p_payload, p_len);
    }
    
    if (expected_crc != p_crc_rx) {
        LOG_WRN("CRC mismatch");
        rx_err_cnt++;
        return;
    }

    switch (p_type) {
        case MSG_GET_STATUS:
            handle_get_status();
            break;
        case MSG_SET_PARAM:
            handle_set_param(p_payload, p_len);
            break;
        case MSG_GET_PARAM:
            handle_get_param(p_payload, p_len);
            break;
        case MSG_RESET_MOD:
            state_machine_trigger_reset();
            break;
        default:
            rx_err_cnt++;
            LOG_WRN("Unknown message type");
            break;
    }
}

static void uart_callback(const struct device *dev, void *user_data) {
    if (!uart_irq_update(dev)) return;

    if (uart_irq_rx_ready(dev)) {
        uint8_t c;
        while (uart_fifo_read(dev, &c, 1) == 1) {
            switch(p_state) {
                case SYNC0: if(c==FRAME_PREAMBLE_0) p_state=SYNC1; break;
                case SYNC1: if(c==FRAME_PREAMBLE_1) p_state=VERSION; else p_state=SYNC0; break;
                case VERSION: if(c==FRAME_VERSION) p_state=TYPE; else p_state=SYNC0; break;
                case TYPE: p_type = c; p_state=LEN0; break;
                case LEN0: p_len = (c << 8); p_state=LEN1; break;
                case LEN1: p_len |= c; 
                           if(p_len > MAX_PAYLOAD_LEN) p_state=SYNC0; 
                           else if(p_len > 0) { p_state=PAYLOAD; p_payload_idx=0; }
                           else p_state=CRC0; 
                           break;
                case PAYLOAD: p_payload[p_payload_idx++] = c; 
                              if(p_payload_idx == p_len) p_state=CRC0; 
                              break;
                case CRC0: p_crc_rx = (c << 8); p_state=CRC1; break;
                case CRC1: p_crc_rx |= c; process_frame(); p_state=SYNC0; break;
            }
        }
    }
}

void uart_protocol_init(void) {
    if (!device_is_ready(uart_dev)) {
        LOG_ERR("UART device not ready");
        return;
    }
    uart_irq_callback_set(uart_dev, uart_callback);
    uart_irq_rx_enable(uart_dev);
    LOG_INF("UART Protocol RX listening");
}
```

## src/uart_protocol.h
```c
#ifndef UART_PROTOCOL_H
#define UART_PROTOCOL_H

#include <stdint.h>
#include <stdbool.h>

// Frame constants
#define FRAME_PREAMBLE_0 0xAA
#define FRAME_PREAMBLE_1 0x55
#define FRAME_VERSION    0x01

// Message Types
#define MSG_GET_STATUS     0x01
#define MSG_STATUS_RSP     0x02
#define MSG_SET_PARAM      0x03
#define MSG_GET_PARAM      0x04
#define MSG_PARAM_RSP      0x05
#define MSG_RESET_MOD      0x06
#define MSG_ERROR_RSP      0x07

void uart_protocol_init(void);

#endif /* UART_PROTOCOL_H */
```
